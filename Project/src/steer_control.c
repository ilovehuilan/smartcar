#include "common.h"
#include "steer_control.h"
#include "ftm.h"
#include "picture.h"
#include "oled.h"
#include "key_scan.h"

#define  GER            1
#define serve_row       0
#define ServeKp_numL   80
#define ServeKp_numR   80
#define row_num        9     

/**********舵机相关控制*************/
//                            1     2    3     4    5     6      7    8     9    10    11     12
//float row_percent[row_num]={0.454,0.32,0.151,0.05,0.005,0.005,0.005,0.005,0.005};
//                            1     2    3   4    5    6   7     8    9
// float row_percent[row_num]={0.25,0.25,0.25,0.08,0.08,0.08,0.01,0.01,0.01};
 float row_percent[row_num]={0.3,0.25,0.20,0.15,0.10,0.05,0.01,0.01,0.01};
//                            22   24   26   28   30   32   34   36   38) 



//float row_percent[row_num]={0.35,0.35,0.35,0.08,0.08,0.08,0.01,0.01,0.01};

int DeltaX=0;
int DeltaX_error=0;
int Control=714;
int Control_error=0;
extern int effective_line;
extern int centerline_save[H];
int abs(int error);

uint32_t  S_3010_centervalue=714;  
uint32_t  Control_left_limit=810;
uint32_t  Control_right_limit=620;
//uint32_t  S_3010_centervalue=617;
//uint32_t  Control_left_limit=700;
//uint32_t  Control_right_limit=540;
/*========================================================================
*  函数名称:  S3010_init
*  功能说明：舵机初始化
*  创建时间：2015/04/13
*  修改时间：2015/04/14
*  参数说明：
========================================================================*/
void S3010_init()
{
      
          FTM_PWM_QuickInit(FTM3_CH0_PE05, kPWM_EdgeAligned, 50); // 0~1000表示0%~100%      占空比，占：整个周期。duty=我们需要的时间*频率*精度
          FTM_PWM_InvertPolarity(HW_FTM3,HW_FTM_CH0, kFTM_QD_InvertedPolarity);
         FTM_PWM_ChangeDuty(HW_FTM3, HW_FTM_CH0, S_3010_centervalue); 
//          FTM_PWM_ChangeDuty(HW_FTM3, HW_FTM_CH0, 810); 
}

/*========================================================================
*  函数名称:  steer_control
*  功能说明：舵机控制
*  创建时间：2015/04/13
*  修改时间：2015/04/14
*  参数说明：
========================================================================*/
void  steer_control()
{

//                                     
//  float Serve_KpL[8][ServeKp_numL]={  0, 0.8223, 0.9216, 1.012, 1.094, 1.167, 1.231, 1.286, 1.333, 1.371, 1.4, 1.42, 1.432,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 1.063,
//                                      0, 0.8223, 0.9216, 1.012, 1.094, 1.167, 1.231, 1.286, 1.333, 1.371, 1.4, 1.42, 1.432,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 1.063,
//                                      0, 0.8223, 0.9216, 1.012, 1.094, 1.167, 1.231, 1.286, 1.333, 1.371, 1.4, 1.42, 1.432,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 1.063 ,
//                                      0, 0.8223, 0.9216, 1.012, 1.094, 1.167, 1.231, 1.286, 1.333, 1.371, 1.4, 1.42, 1.432,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 1.063,
//                                      0, 0.8223, 0.9216, 1.012, 1.094, 1.167, 1.231, 1.286, 1.333, 1.371, 1.4, 1.42, 1.432,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 1.063,
//                                      0, 0.8223, 0.9216, 1.012, 1.094, 1.167, 1.231, 1.286, 1.333, 1.371, 1.4, 1.42, 1.432,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 1.063,
//                                      0, 0.8223, 0.9216, 1.012, 1.094, 1.167, 1.231, 1.286, 1.333, 1.371, 1.4, 1.42, 1.432,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 1.063,
//                                      0, 0.8223, 0.9216, 1.012, 1.094, 1.167, 1.231, 1.286, 1.333, 1.371, 1.4, 1.42, 1.432,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 1.063,
//                                    };
//    float Serve_KpR[8][ServeKp_numR]={  0, 0.8223, 0.9216, 1.012, 1.094, 1.167, 1.231, 1.286, 1.333, 1.371, 1.4, 1.42, 1.432,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 1.063,
//                                      0, 0.8223, 0.9216, 1.012, 1.094, 1.167, 1.231, 1.286, 1.333, 1.371, 1.4, 1.42, 1.432,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 1.063,
//                                      0, 0.8223, 0.9216, 1.012, 1.094, 1.167, 1.231, 1.286, 1.333, 1.371, 1.4, 1.42, 1.432,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 1.063 ,
//                                      0, 0.8223, 0.9216, 1.012, 1.094, 1.167, 1.231, 1.286, 1.333, 1.371, 1.4, 1.42, 1.432,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 1.063,
//                                      0, 0.8223, 0.9216, 1.012, 1.094, 1.167, 1.231, 1.286, 1.333, 1.371, 1.4, 1.42, 1.432,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 1.063,
//                                      0, 0.8223, 0.9216, 1.012, 1.094, 1.167, 1.231, 1.286, 1.333, 1.371, 1.4, 1.42, 1.432,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 1.063,
//                                      0, 0.8223, 0.9216, 1.012, 1.094, 1.167, 1.231, 1.286, 1.333, 1.371, 1.4, 1.42, 1.432,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 1.063,
//                                      0, 0.8223, 0.9216, 1.012, 1.094, 1.167, 1.231, 1.286, 1.333, 1.371, 1.4, 1.42, 1.432,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 1.063,
//                                     };
//    
//
  float Serve_KpR[8][ServeKp_numL]={ 4.8686,1.3592,1.5168,1.5912,1.6323,1.6567,1.6716,1.6805,1.6855,1.6877,1.6879,1.6865,1.6840,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1.1612,1.1524};
  float Serve_KpL[8][ServeKp_numR]={ 8.3761,4.4599,3.1587,2.5112,2.1253,1.8701,1.6897,1.5559,1.4533,1.3724,1.3075,1.2544,1.2104,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1.1294,};

//                  float Serve_Kd_in=112;//进弯
//                  float Serve_Kd_out=65;//出弯
    
                  float Serve_Kd_in=0;//进弯
                  float Serve_Kd_out=0;//出弯
                  
                  int i=0;
                  int row=0;
                  int DeltaX_last=0;  //上一次的偏差量
                  float center_err=0;      //浮点型中线加权量
                  
                 
                  //判断中线大致趋势，中线归一化
                  if(effective_line>=0)        
                  {
                    if(centerline[H/GER-1]<centerline[effective_line])
                      for(row=effective_line;row>0;row--)
                        centerline[row]=W;
                    else if(centerline[H/GER-1]>centerline[effective_line])
                      for(row=effective_line;row>0;row--)
                        centerline[row]=0;
                    else 
                    {
                      for(row=effective_line;row>0;row--)
                        centerline[row]=W/2;
                    }
                  }
                   //中线加权
                  for(row=22;row<48;row++)    
                  {
                  if(row==22 || row==24 || row==26 || row==28 || row==30 || row==32 || row==34 || row==36 || row==38)                 
 //                   if(row==22 || row==24 || row==26 || row==30 || row==32 || row==34 || row==44 || row==46 || row==48)
                    {
                      center_err+=(W/2-centerline[row])*row_percent[i];  //正数左负数右
                      i++;
                    }
                  }
          
                  /******************/
                  /*****坡道判断*****/
                  /*****选择控制行****/
                /////偏差
                DeltaX_last=DeltaX;
//                if(ramp_flag >= 1 )
//                {
//                    DeltaX=centerline[42]-W/2;
//                }
//                else
//                {
//                  DeltaX=-(int)((center_err));
                DeltaX=(int)center_err;

   
                Control_error=DeltaX-DeltaX_last;
                /******************/
                /*****小S路径优化**/
                /*******削弱偏差***/
                
                ///偏差限幅
                if(DeltaX>=W/2) DeltaX=W/2;
                if(DeltaX<=-W/2) DeltaX=-W/2;
//                Control_last=Control;
                

//                //Kp修改
//                if(effective_line<10)
//                {
//                  Serve_KpL[serve_row][abs(DeltaX)]+=0.0;
//                  Serve_KpR[serve_row][abs(DeltaX)]+=0.0;
//                }
//                else
//                {
                  if(abs(DeltaX)>5 && abs(DeltaX)<40) 
                  {
                    Serve_KpL[serve_row][abs(DeltaX)]+=0.2;
                    Serve_KpR[serve_row][abs(DeltaX)]+=0.0;
                  }
                  if(abs(DeltaX)>=40 && abs(DeltaX)<80)
                  {
                    Serve_KpL[serve_row][abs(DeltaX)]+=0.2;
                    Serve_KpR[serve_row][abs(DeltaX)]+=0.0;
                  }
//                }
                
                  /******************/
                  /*****障碍识别*****/
                  /*****修改Kp值*****/
                
                  if(DeltaX>0&&DeltaX<ServeKp_numL)             // error大于零，左转
                  {
                    if(DeltaX*(DeltaX-DeltaX_last)>0)           //偏差减去偏差的变化大于零判断为出弯
                      Control=(int)(Serve_KpL[serve_row][abs(DeltaX)]*DeltaX+Serve_Kd_in*Control_error)+S_3010_centervalue;
                    else if(DeltaX*(DeltaX-DeltaX_last)<=0) 
                      Control=(int)(Serve_KpL[serve_row][abs(DeltaX)]*DeltaX+Serve_Kd_out*Control_error)+S_3010_centervalue;
                  }
                  else if(DeltaX<=0&&DeltaX>-ServeKp_numR)     //error小于零，右转
                  {
                    if(DeltaX*(DeltaX-DeltaX_last)>0)
                      Control=(int)(Serve_KpR[serve_row][abs(DeltaX)]*DeltaX+Serve_Kd_in*Control_error)+S_3010_centervalue;
                    else if(DeltaX*(DeltaX-DeltaX_last)<=0) 
                      Control=(int)(Serve_KpR[serve_row][abs(DeltaX)]*DeltaX+Serve_Kd_out*Control_error)+S_3010_centervalue;
                    //输出=偏差*kp+偏差变化*kd
                  }
//                }
                else if(DeltaX>=ServeKp_numL )    //这一段没必要，因为下面存在舵机限幅
                  Control=Control_left_limit;
                else if(DeltaX<=-ServeKp_numR)
                  Control=Control_right_limit;
                ///舵机限幅
                if(Control>Control_left_limit)  
                  Control=Control_left_limit;
                if(Control<Control_right_limit) 
                  Control=Control_right_limit;
                ///赋值舵机
//                FTM_PWM_ChangeDuty(HW_FTM3, HW_FTM_CH0, Control); 
                FTM_PWM_ChangeDuty(HW_FTM0, HW_FTM_CH0, 2700); //左电机正
                FTM_PWM_ChangeDuty(HW_FTM0, HW_FTM_CH1, 0);
                FTM_PWM_ChangeDuty(HW_FTM0, HW_FTM_CH2, 0); //右电机正
                FTM_PWM_ChangeDuty(HW_FTM0, HW_FTM_CH3, 2700);
//                KEY_Scan();
//
//                LCD_set_XY(0, 1);
//                LCD_write_english("DeltaX=");
//                LCD_write_int(DeltaX);
//                LCD_write_english(",");
//                LCD_write_int(DeltaX);
//
//
//                
//                LCD_set_XY(0, 2);
//                LCD_write_english("low=");
//                LCD_write_int(centerline[38]);
//                LCD_write_english(",");
//                LCD_write_int(centerline[36]);
//                LCD_write_english(",");
//                LCD_write_int(centerline[34]);
//                LCD_write_english(",");
//                LCD_write_int(centerline[34]);
//
//
//                LCD_set_XY(0, 3);
//                LCD_write_english("mediun=");
//                LCD_write_int(centerline[32]);
//                LCD_write_english(",");
//                LCD_write_int(centerline[30]);
//                LCD_write_english(",");
//                LCD_write_int(centerline[28]);
//                LCD_write_english(",");
//                LCD_write_int(centerline[28]);//////33,35,37
//
//
//                LCD_set_XY(0, 4);
//                LCD_write_english("hight=");
//                LCD_write_int(centerline[26]);
//                LCD_write_english(",");
//                LCD_write_int(centerline[24]);
//                LCD_write_english(",");
//                LCD_write_int(centerline[22]);
//                LCD_write_english(",");
//                LCD_write_int(centerline[22]);
//                
//                LCD_set_XY(0, 5);
//                LCD_write_int(Control);
                FTM_PWM_ChangeDuty(HW_FTM3, HW_FTM_CH0, Control); 

  
}
/*========================================================================
*  函数名称:  S3010_set
*  功能说明：舵机赋值
*  创建时间：2015/04/13
*  修改时间：2015/04/14
*  参数说明：
========================================================================*/
void S3010_set(uint32_t pwm)
{

  FTM_PWM_ChangeDuty(HW_FTM3, HW_FTM_CH0, pwm); 
}

int abs(int error)
{
  if(error<0)
    error = 0-error;
  return error;
}